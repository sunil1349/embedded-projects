## CMakeLists.txt
```
cmake_minimum_required(VERSION 3.20.0)

find_package(Zephyr REQUIRED HINTS $ENV{ZEPHYR_BASE})
project(uart_driver)

target_sources(app PRIVATE
    src/main.c
    src/ring_buffer.c
    src/uart_driver.c
    src/command_parser.c
    src/led_driver.c
)

target_include_directories(app PRIVATE
    includes
)
```

## prj.conf
```kconfig
CONFIG_GPIO=y
CONFIG_SERIAL=y
CONFIG_UART_INTERRUPT_DRIVEN=y
CONFIG_PRINTK=y
CONFIG_CONSOLE=y
CONFIG_UART_CONSOLE=y
```

## boards/esp32_devkitc_esp32_procpu.overlay
```dts
/ {
    leds {
        compatible = "gpio-leds";

        led0: led_0 {
            gpios = <&gpio0 2 GPIO_ACTIVE_HIGH>;
            label = "User LED";
        };
    };

    aliases {
        led0 = &led0;
    };
};
```

## src/main.c
```c
#include <zephyr/kernel.h>
#include <zephyr/sys/printk.h>

#include "uart_driver.h"
#include "command_parser.h"
#include "led_driver.h"

int main(void)
{
    uint8_t c;

    if (uart_driver_init() != 0) {
        printk("UART driver init failed\n");
        return 0;
    }

    if (led_driver_init() != 0) {
        printk("LED driver init failed\n");
    }

    command_parser_init();

    while (1) {
        if (uart_driver_get_char(&c)) {
            command_parser_process_char((char)c);
        }
    }

    return 0;
}
```

## src/command_parser.c
```c
#include <string.h>
#include <stdbool.h>

#include "command_parser.h"
#include "led_driver.h"
#include "uart_driver.h"

#define CMD_BUF_SIZE 64

static char cmd_buf[CMD_BUF_SIZE];
static uint8_t cmd_pos;
static bool echo_enabled = true;

static void process_command(const char *cmd)
{
    if (strcmp(cmd, "help") == 0) {
        uart_driver_send_string("\r\nCommands:\r\n");
        uart_driver_send_string("  help\r\n");
        uart_driver_send_string("  status\r\n");
        uart_driver_send_string("  echo on\r\n");
        uart_driver_send_string("  echo off\r\n");
        uart_driver_send_string("  led on\r\n");
        uart_driver_send_string("  led off\r\n");
        uart_driver_send_string("  led toggle\r\n");
    } else if (strcmp(cmd, "status") == 0) {
        uart_driver_send_string("\r\nSystem OK\r\n");
    } else if (strcmp(cmd, "echo on") == 0) {
        echo_enabled = true;
        uart_driver_send_string("\r\nEcho enabled\r\n");
    } else if (strcmp(cmd, "echo off") == 0) {
        echo_enabled = false;
        uart_driver_send_string("\r\nEcho disabled\r\n");
    }
    else if (strcmp(cmd, "led on") == 0) 
    {
        led_driver_on();
        uart_driver_send_string("\r\nLED ON\r\n");
    } 
    else if (strcmp(cmd, "led off") == 0) 
    {
        led_driver_off();
        uart_driver_send_string("\r\nLED OFF\r\n");
    }
    else if (strcmp(cmd, "led toggle") == 0) 
    {
        led_driver_toggle();
        uart_driver_send_string("\r\nLED TOGGLED\r\n");
    }
    else if (cmd[0] != '\0') {
        uart_driver_send_string("\r\nUnknown command\r\n");
    }

    uart_driver_send_string("> ");
}

void command_parser_init(void)
{
    cmd_pos = 0;
    memset(cmd_buf, 0, sizeof(cmd_buf));

    uart_driver_send_string("\r\nCommand parser started\r\n");
    uart_driver_send_string("Type 'help'\r\n");
    uart_driver_send_string("> ");
}

void command_parser_process_char(char ch)
{
    if (echo_enabled) {
        uart_driver_send_char((uint8_t)ch);
    }

    if (ch == '\r' || ch == '\n') {
        cmd_buf[cmd_pos] = '\0';
        process_command(cmd_buf);
        cmd_pos = 0;
        memset(cmd_buf, 0, sizeof(cmd_buf));
        return;
    }

    if (ch == '\b' || ch == 127) {
        if (cmd_pos > 0) {
            cmd_pos--;
            cmd_buf[cmd_pos] = '\0';
        }
        return;
    }

    if (cmd_pos < CMD_BUF_SIZE - 1) {
        cmd_buf[cmd_pos++] = ch;
    } else {
        uart_driver_send_string("\r\nCommand too long\r\n");
        cmd_pos = 0;
        memset(cmd_buf, 0, sizeof(cmd_buf));
        uart_driver_send_string("> ");
    }
} 
```

## src/led_driver.c
```c
#include <zephyr/device.h>
#include <zephyr/drivers/gpio.h>
#include <errno.h>

#include "led_driver.h"

#define LED0_NODE DT_ALIAS(led0)

static const struct gpio_dt_spec led =
    GPIO_DT_SPEC_GET(LED0_NODE, gpios);

int led_driver_init(void)
{
    int ret;

    if (!gpio_is_ready_dt(&led)) {
        return -ENODEV;
    }

    ret = gpio_pin_configure_dt(&led, GPIO_OUTPUT_INACTIVE);
    if (ret < 0) {
        return ret;
    }

    return 0;
}

void led_driver_on(void)
{
    gpio_pin_set_dt(&led, 1);
}

void led_driver_off(void)
{
    gpio_pin_set_dt(&led, 0);
}

void led_driver_toggle(void)
{
    gpio_pin_toggle_dt(&led);
}
```

## src/ring_buffer.c
```c
#include <ring_buffer.h>






void ring_buffer_init(struct ring_buffer *rb)
{
    rb->head = 0;
    rb->tail = 0;
    rb->overflow_count = 0;
}

bool ring_buffer_is_full(struct ring_buffer *rb)
{
    uint16_t next_head = (rb->head + 1) % UART_BUF_SIZE;
    return next_head == rb->tail;
}

bool ring_buffer_is_empty(struct ring_buffer *rb)
{
    return rb->head == rb->tail;
}

bool ring_buffer_push(struct ring_buffer *rb, uint8_t data)
{
    uint16_t next_head = (rb->head + 1) % UART_BUF_SIZE;

    if (next_head == rb->tail) {
        rb->overflow_count++;
        return false;
    }

    rb->data[rb->head] = data;
    rb->head = next_head;

    return true;
}

bool ring_buffer_pop(struct ring_buffer *rb, uint8_t *data)
{
    if (ring_buffer_is_empty(rb)) {
        return false;
    }

    *data = rb->data[rb->tail];
    rb->tail = (rb->tail + 1) % UART_BUF_SIZE;

    return true;
}
```

## src/uart_driver.c
```c
#include <zephyr/kernel.h>
#include <zephyr/device.h>
#include <zephyr/drivers/uart.h>
#include <zephyr/sys/printk.h>
#include <errno.h>

#include "uart_driver.h"
#include "ring_buffer.h"

#define UART_DEVICE_NODE DT_CHOSEN(zephyr_console)

static const struct device *uart_dev =
    DEVICE_DT_GET(UART_DEVICE_NODE);

static struct ring_buffer rx_rb;

K_SEM_DEFINE(uart_rx_sem, 0, 1);

static void uart_cb(const struct device *dev, void *user_data)
{
    uint8_t c;
    bool data_received = false;

    ARG_UNUSED(user_data);

    if (!uart_irq_update(dev)) {
        return;
    }

    if (uart_irq_rx_ready(dev)) {
        while (uart_fifo_read(dev, &c, 1) == 1) {
            ring_buffer_push(&rx_rb, c);
            data_received = true;
        }
    }

    if (data_received) {
        k_sem_give(&uart_rx_sem);
    }
}

int uart_driver_init(void)
{
    if (!device_is_ready(uart_dev)) {
        printk("UART device not ready\n");
        return -ENODEV;
    }

    ring_buffer_init(&rx_rb);

    uart_irq_callback_user_data_set(uart_dev, uart_cb, NULL);
    uart_irq_rx_enable(uart_dev);

    return 0;
}

bool uart_driver_get_char(uint8_t *ch)
{
    if (ch == NULL) {
        return false;
    }

    while (!ring_buffer_pop(&rx_rb, ch)) {
        k_sem_take(&uart_rx_sem, K_FOREVER);
    }

    return true;
}

void uart_driver_send_char(uint8_t ch)
{
    uart_poll_out(uart_dev, ch);
}

void uart_driver_send_string(const char *str)
{
    if (str == NULL) {
        return;
    }

    while (*str != '\0') {
        uart_driver_send_char((uint8_t)*str);
        str++;
    }
}
```
